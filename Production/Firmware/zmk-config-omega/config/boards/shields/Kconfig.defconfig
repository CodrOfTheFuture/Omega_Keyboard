## Production/Firmware/zmk-config-omega/config/boards/shields/Kconfig.defconfig
```kconfig
if SHIELD_OMEGA_LEFT

config ZMK_KEYBOARD_NAME
    default "Omega"

config ZMK_SPLIT_ROLE_CENTRAL
    default y

endif

if SHIELD_OMEGA_LEFT || SHIELD_OMEGA_RIGHT

config ZMK_SPLIT
    default y

endif
```

## Production/zmk-config-omega/config/boards/shields/Kconfig.shield
```kconfig
config SHIELD_OMEGA_LEFT
    def_bool $(shields_list_contains,omega_left)

config SHIELD_OMEGA_RIGHT
    def_bool $(shields_list_contains,omega_right)
```
